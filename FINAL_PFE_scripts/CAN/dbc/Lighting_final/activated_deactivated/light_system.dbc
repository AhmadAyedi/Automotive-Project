VERSION "Khalil Light Control System 1.0"

NS_ :

BS_:

BU_: MASTER SLAVE

BO_ 257 LOW_BEAM_CTRL: 2 MASTER
 SG_ LOW_BEAM_STATUS : 0|8@1+ (1,0) [0|1] "" SLAVE
 SG_ LOW_BEAM_MODE : 8|8@1+ (1,0) [0|3] "" SLAVE

BO_ 258 HIGH_BEAM_CTRL: 2 MASTER
 SG_ HIGH_BEAM_STATUS : 0|8@1+ (1,0) [0|1] "" SLAVE
 SG_ HIGH_BEAM_MODE : 8|8@1+ (1,0) [0|3] "" SLAVE

BO_ 259 PARKING_LEFT_CTRL: 2 MASTER
 SG_ PARKING_LEFT_STATUS : 0|8@1+ (1,0) [0|1] "" SLAVE
 SG_ PARKING_LEFT_MODE : 8|8@1+ (1,0) [0|3] "" SLAVE

BO_ 260 PARKING_RIGHT_CTRL: 2 MASTER
 SG_ PARKING_RIGHT_STATUS : 0|8@1+ (1,0) [0|1] "" SLAVE
 SG_ PARKING_RIGHT_MODE : 8|8@1+ (1,0) [0|3] "" SLAVE

BO_ 261 HAZARD_LIGHTS_CTRL: 2 MASTER
 SG_ HAZARD_LIGHTS_STATUS : 0|8@1+ (1,0) [0|1] "" SLAVE
 SG_ HAZARD_LIGHTS_MODE : 8|8@1+ (1,0) [0|3] "" SLAVE

BO_ 262 RIGHT_TURN_CTRL: 2 MASTER
 SG_ RIGHT_TURN_STATUS : 0|8@1+ (1,0) [0|1] "" SLAVE
 SG_ RIGHT_TURN_MODE : 8|8@1+ (1,0) [0|3] "" SLAVE

BO_ 263 LEFT_TURN_CTRL: 2 MASTER
 SG_ LEFT_TURN_STATUS : 0|8@1+ (1,0) [0|1] "" SLAVE
 SG_ LEFT_TURN_MODE : 8|8@1+ (1,0) [0|3] "" SLAVE

VAL_ 257 LOW_BEAM_STATUS 0 "DEACTIVATED" 1 "ACTIVATED" 255 "FAILED" 254 "INVALID";
VAL_ 257 LOW_BEAM_MODE 0 "FAHREN" 1 "STAND" 2 "PARKING" 3 "WOHNEN";

VAL_ 258 HIGH_BEAM_STATUS 0 "DEACTIVATED" 1 "ACTIVATED" 255 "FAILED" 254 "INVALID";
VAL_ 258 HIGH_BEAM_MODE 0 "FAHREN" 1 "STAND" 2 "PARKING" 3 "WOHNEN";

VAL_ 259 PARKING_LEFT_STATUS 0 "DEACTIVATED" 1 "ACTIVATED" 255 "FAILED" 254 "INVALID";
VAL_ 259 PARKING_LEFT_MODE 0 "FAHREN" 1 "STAND" 2 "PARKING" 3 "WOHNEN";

VAL_ 260 PARKING_RIGHT_STATUS 0 "DEACTIVATED" 1 "ACTIVATED" 255 "FAILED" 254 "INVALID";
VAL_ 260 PARKING_RIGHT_MODE 0 "FAHREN" 1 "STAND" 2 "PARKING" 3 "WOHNEN";

VAL_ 261 HAZARD_LIGHTS_STATUS 0 "DEACTIVATED" 1 "ACTIVATED" 255 "FAILED" 254 "INVALID";
VAL_ 261 HAZARD_LIGHTS_MODE 0 "FAHREN" 1 "STAND" 2 "PARKING" 3 "WOHNEN";

VAL_ 262 RIGHT_TURN_STATUS 0 "DEACTIVATED" 1 "ACTIVATED" 255 "FAILED" 254 "INVALID";
VAL_ 262 RIGHT_TURN_MODE 0 "FAHREN" 1 "STAND" 2 "PARKING" 3 "WOHNEN";

VAL_ 263 LEFT_TURN_STATUS 0 "DEACTIVATED" 1 "ACTIVATED" 255 "FAILED" 254 "INVALID";
VAL_ 263 LEFT_TURN_MODE 0 "FAHREN" 1 "STAND" 2 "PARKING" 3 "WOHNEN";
